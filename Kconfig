## dts/bindings/behaviors/zmk,behavior-ble-shell-adv.yaml
```yaml
description: |
  BLE shell advertise behavior.

  When triggered from a keymap binding this behavior starts an extended
  advertising set that broadcasts the zmk-ble-shell GATT service UUID,
  allowing a management UI (MUI) client to discover and connect to the
  device even while a HID profile is already bonded and connected.

  Advertising stops automatically after CONFIG_ZMK_BLE_SHELL_ADV_TIMEOUT
  seconds if no client subscribes to the shell characteristic.

compatible: "zmk,behavior-ble-shell-adv"

include: zero_param.yaml

properties: {}
```

## src/Kconfig
```kconfig
config ZMK_BLE_SHELL
    bool "ZMK BLE Shell GATT service"
    depends on BT
    depends on SHELL
    select SHELL_BACKEND_DUMMY
    default y
    help
      Exposes a custom GATT service (UUID c901c4e9-...) with a single
      NOTIFY+WRITE_WITHOUT_RESP characteristic.  Written payloads are
      executed as Zephyr shell commands and the output is relayed back
      via BLE notifications.  While the client has notifications enabled,
      ZMK log output is also forwarded through the same channel.

if ZMK_BLE_SHELL

config ZMK_BLE_SHELL_TX_BUF_SIZE
    int "TX ring-buffer size (bytes)"
    default 2048
    help
      Bytes reserved for outgoing data (shell command output + log lines)
      before they are sent over BLE.  Oldest data is dropped when the
      buffer is full.

config ZMK_BLE_SHELL_CMD_BUF_SIZE
    int "Maximum shell command length (bytes, including NUL)"
    default 256

config ZMK_BLE_SHELL_LOG_BUF_SIZE
    int "Log-formatting scratch buffer size (bytes)"
    default 160
    help
      Intermediate buffer used when formatting a single log message
      before it is placed in the TX ring buffer.

endif # ZMK_BLE_SHELL
```

## src/behaviors/Kconfig
```kconfig
# SPDX-License-Identifier: MIT

config ZMK_BLE_SHELL_ADV_BEHAVIOR
    bool "BLE shell advertise behavior"
    depends on ZMK_BLE_SHELL
    help
      Adds the zmk,behavior-ble-shell-adv ZMK behavior.  When triggered
      from a keymap binding it starts a connectable legacy advertising
      session that broadcasts the shell GATT service UUID.  This allows a
      management UI client to discover and connect to the device.
      Advertising stops automatically after ZMK_BLE_SHELL_ADV_TIMEOUT
      seconds if no client subscribes to the shell characteristic.
      Requires BT_MAX_CONN > 1 to accept the second connection.

config ZMK_BLE_SHELL_ADV_TIMEOUT
    int "MUI advertisement timeout (seconds)"
    depends on ZMK_BLE_SHELL_ADV_BEHAVIOR
    default 30
    help
      How many seconds to advertise the shell service before giving up
      when no management UI client subscribes.
```

## src/ble_shell/Kconfig
```kconfig
# SPDX-License-Identifier: MIT

config ZMK_BLE_SHELL
    bool "ZMK BLE Shell GATT service"
    depends on BT
    depends on SHELL
    select ZMK_SHELL_RELAY_CORE
    default y
    help
      Exposes a custom GATT service (UUID c901c4e9-...) with a single
      NOTIFY+WRITE_WITHOUT_RESP characteristic.  Written payloads are
      executed as Zephyr shell commands and the output is relayed back
      via BLE notifications.  While the client has notifications enabled,
      ZMK log output is also forwarded through the same channel.

if ZMK_BLE_SHELL

config ZMK_BLE_SHELL_CMD_BUF_SIZE
    int "Maximum shell command length (bytes, including NUL)"
    default 256

config ZMK_BLE_SHELL_LOG_BUF_SIZE
    int "Log-formatting scratch buffer size (bytes)"
    default 256

config ZMK_BLE_SHELL_INJECT_RETRY_INTERVAL
    int "Interval for attempts of injecting the new advertising data"
    default 5

config ZMK_BLE_SHELL_INJECT_RETRY_MAX
    int "Attempts for injecting"
    default 25

config ZMK_BLE_SHELL_INJECT_AFTER_SWITCH_MS
    int "Inject advertising data in this amount of ms after profile switch"
    default 1

config ZMK_BLE_SHELL_PROMPT_EN
    bool "Send prompt after connect and each command"
    default y

config ZMK_BLE_SHELL_PROMPT
    string "BLE shell prompt string"
    depends on ZMK_BLE_SHELL_PROMPT_EN
    default SHELL_PROMPT_UART

config ZMK_BLE_SHELL_DATA_CHANNEL
    bool "BLE data push channel (second NOTIFY characteristic)"
    default y

config ZMK_BLE_SHELL_DATA_TX_BUF_SIZE
    int "Data channel TX ring-buffer size (bytes)"
    depends on ZMK_BLE_SHELL_DATA_CHANNEL
    default 128

endif # ZMK_BLE_SHELL
```
